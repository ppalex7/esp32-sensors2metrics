## main/Kconfig.projbuild
```kconfig
menu "WiFi Configuration"
    config WIFI_MAXIMUM_RETRY
        int "Maximum connection attempts"
        default 5
                
endmenu

menu "Local web server"
    config LOCAL_WEB_SERVER_ENABLED
        bool "Enable local HTTP server"
        default y
        help
            Serve the sensor status page and JSON API over HTTP.
            Disable for battery-powered devices that use deep sleep.
            When enabled, monitoring labels are stored in NVS.
            When disabled, configure them in Yandex.Monitoring configuration.
endmenu

menu "Yandex.Monitoring configuration"
        config MONITORING_FOLDER
        string "Yandex Cloud Folder id"

        config MONITORING_LABEL_LOCATION
        string "Value for label 'location'"
        depends on !LOCAL_WEB_SERVER_ENABLED
        default ""

        config MONITORING_LABEL_ROOM
        string "Value for label 'room'"
        depends on !LOCAL_WEB_SERVER_ENABLED
        default ""
endmenu

menu "Sensors Configuration"

    choice PRESSURE_SENSOR_TYPE
        prompt "Select pressure sensor"
        default SENSOR_BMP580
        config SENSOR_BMP580
            bool "BMP580"
        config SENSOR_BME280
            bool "BME280"
        help
            Choose which sensor is connected to the I2C bus for pressure/temperature
    endchoice

    config PRESSURE_SENSOR_NAME
        string
        default "BMP580" if SENSOR_BMP580
        default "BME280" if SENSOR_BME280
        default "Unknown"

    config I2C_MASTER_SCL
        int "SCL GPIO Num"
        default 4 if CONFIG_IDF_TARGET_ESP32C3
        default 2 if CONFIG_IDF_TARGET_ESP32C6
        help
            GPIO number for I2C Master clock line.

    config I2C_MASTER_SDA
        int "SDA GPIO Num"
        default 5 if CONFIG_IDF_TARGET_ESP32C3
        default 3 if CONFIG_IDF_TARGET_ESP32C6
        help
            GPIO number for I2C Master data line.
        
    config I2C_TIMEOUT_VALUE_MS
        int "Timeout in millisecods for I2C operations"
        default 50

endmenu

menu "Application debug options"
    
    config DEBUG_PIN
        int "DEBUG GPIO num"
        default 10
        help
            GPIO number for debug label in metrics

    config DEBUG_HTTP_CLIENT
        bool "Enable debug for http_client"
        default 0
        help 
            Verbose logs and response printing
endmenu
```
