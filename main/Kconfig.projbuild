## main/Kconfig.projbuild
```kconfig
menu "WiFi Configuration"
    config WIFI_SSID
        string "WiFi SSID"
        default "myssid"
        help
            SSID (network name) to connect to.

    config WIFI_PASSWORD
        string "WiFi Password"
        default "mypassword"
        help
            WiFi password to use.
    
    config WIFI_MAXIMUM_RETRY
        int "Maximum connection attempts"
        default 5
                
endmenu

menu "Yandex.Monitoring configuration"
        config MONITORING_FOLDER
        string "Yandex Cloud Folder id"
        
        config MONITORING_TOKEN
        string "Token for Yandex.Monitoring"

        config MONITORING_LABEL_LOCATION
        string "Value for label 'location'"
        
        config MONITORING_LABEL_ROOM
        string "Value for label 'room'"
endmenu

menu "I2C Configuration"
    config I2C_MASTER_SCL
        int "SCL GPIO Num"
        default 19 if IDF_TARGET_ESP32
        default 4
        help
            GPIO number for I2C Master clock line.

    config I2C_MASTER_SDA
        int "SDA GPIO Num"
        default 18 if IDF_TARGET_ESP32
        default 5
        help
            GPIO number for I2C Master data line.

    config I2C_TIMEOUT_VALUE_MS
        int "Timeout in millisecods for I2C operations"
        default 50

endmenu

menu "Application debug options"
    config DEBUG_HTTP_CLIENT
    bool "Enable debug for http_client"
    default 0
    help 
        Verbose logs and response printing
endmenu
```
